## conf/layer.conf
```bitbake
# We have a conf and classes directory, add to BBPATH
BBPATH .= ":${LAYERDIR}"

# We have a recipes directory, add to BBFILES
BBFILES += "${LAYERDIR}/recipes-*/*/*.bb \
        ${LAYERDIR}/recipes-devtools/*/*.bbappend \
	    ${LAYERDIR}/recipes-support/*/*.bbappend \
	    ${LAYERDIR}/recipes-kernel/*/*yocto*.bbappend"

BBFILES_DYNAMIC += "meta-intel:${LAYERDIR}/recipes-kernel/*/*intel*.bbappend"
BBFILES_DYNAMIC += "meta-intel-fpga:${LAYERDIR}/recipes-kernel/*/*socfpga*.bbappend"

BBFILE_COLLECTIONS += "intel-realsense"
BBFILE_PATTERN_intel-realsense:= "^${LAYERDIR}/"
BBFILE_PRIORITY_intel-realsense = "6"

LAYERSERIES_COMPAT_intel-realsense = "walnascar"
LAYERDEPENDS_intel-realsense = "openembedded-layer"
```
